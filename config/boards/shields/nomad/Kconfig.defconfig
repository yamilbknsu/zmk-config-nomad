## config/boards/shields/nomad/Kconfig.defconfig
```kconfig
if SHIELD_NOMAD_LEFT

# Name must be less than 16 characters long!
config ZMK_KEYBOARD_NAME
    default "Nomad"

config ZMK_SPLIT_ROLE_CENTRAL
    default y

endif

if SHIELD_NOMAD_LEFT || SHIELD_NOMAD_RIGHT

config ZMK_SPLIT
    default y

endif
```

## config/boards/shields/nomad/Kconfig.shield
```kconfig
# No whitespace after the comma or in your part name!
config SHIELD_NOMAD_LEFT
    def_bool $(shields_list_contains,nomad_left)

# No whitespace after the comma or in your part name!
config SHIELD_NOMAD_RIGHT
    def_bool $(shields_list_contains,nomad_right)
```
